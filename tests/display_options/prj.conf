## CMakeLists.txt
```
# SPDX-License-Identifier: Apache-2.0

cmake_minimum_required(VERSION 3.20.0)

find_package(Zephyr REQUIRED HINTS $ENV{ZEPHYR_BASE})
project(attr_display_options)

FILE(GLOB app_sources src/main.c src/test*.c)
target_sources(app PRIVATE ${app_sources})
```

## prj.conf
```kconfig
CONFIG_ATTR=y
CONFIG_ATTR_BREAK_ON_LOAD_FAILURE=y
CONFIG_ATTR_SETTINGS_LOCK=y
CONFIG_LCZ=y
CONFIG_LCZ_PARAM_FILE=y
CONFIG_LCZ_PARAM_FILE_SHELL=y
CONFIG_FILE_SYSTEM=y
CONFIG_FILE_SYSTEM_UTILITIES=y
CONFIG_HEAP_MEM_POOL_SIZE=4096
CONFIG_FLASH=y
CONFIG_FLASH_MAP=y
CONFIG_FILE_SYSTEM_LITTLEFS=y
CONFIG_ATTR_DEVICE_OVERRIDE=y
CONFIG_ATTR_DEVICE_OVERRIDE_SOURCE_FOLDER=y
CONFIG_ATTR_DEVICE_OVERRIDE_NAME="attributes"
CONFIG_ATTR_SHOW_FMT="[%u] %s "
CONFIG_ATTR_SHELL=y
CONFIG_ATTR_SHELL_LOCK=n
CONFIG_MCUMGR=y
CONFIG_NEWLIB_LIBC=y
CONFIG_ZTEST=y
CONFIG_TEST_LOGGING_DEFAULTS=n
CONFIG_LOG=y
CONFIG_LOG_PRINTK=n
CONFIG_LOG_MODE_IMMEDIATE=y
CONFIG_SHELL=y
CONFIG_SHELL_BACKENDS=n
CONFIG_SHELL_BACKSPACE_MODE_DELETE=n
CONFIG_SHELL_TAB=n
CONFIG_SHELL_WILDCARD=n
CONFIG_SHELL_ECHO_STATUS=n
CONFIG_SHELL_VT100_COMMANDS=n
CONFIG_SHELL_METAKEYS=n
CONFIG_SHELL_HELP=n
CONFIG_SHELL_HISTORY=n
CONFIG_SHELL_STATS=n
CONFIG_SHELL_CMDS=n
CONFIG_SHELL_LOG_BACKEND=n
CONFIG_KERNEL_SHELL=n
CONFIG_DEVICE_SHELL=n
CONFIG_DEVMEM_SHELL=n
```

## src/main.c
```c
/**
 * @file main.c
 * @brief
 *
 * Copyright (c) 2021 Laird Connectivity
 *
 * SPDX-License-Identifier: Apache-2.0
 */

/******************************************************************************/
/* Includes                                                                   */
/******************************************************************************/
#include "test_attr.h"

/******************************************************************************/
/* Global Function Definitions                                                */
/******************************************************************************/
void test_main(void)
{
	test_attr_setup();

	ztest_test_suite(lcz_attr_basic_api_test,
			 ztest_unit_test(test_attr_defaults),
			 ztest_unit_test(test_attr_with_lock_setup_not_engaged),
			 ztest_unit_test(test_attr_lock_enable),
			 ztest_unit_test(test_attr_with_lock_setup_not_engaged),
			 ztest_unit_test(test_attr_lock_engage),
			 ztest_unit_test(test_attr_with_lock_engaged),
			 ztest_unit_test(test_attr_lock_disengage),
			 ztest_unit_test(test_attr_with_lock_setup_not_engaged),
			 ztest_unit_test(test_attr_lock_engage),
			 ztest_unit_test(test_attr_with_lock_engaged),
			 ztest_unit_test(test_attr_lock_disable),
			 ztest_unit_test(test_attr_with_lock_setup_not_engaged),
			 ztest_unit_test(
				test_attr_show_with_lock_setup_not_engaged),
			 ztest_unit_test(test_attr_dump),
			 ztest_unit_test(
				test_attr_dump_with_lock_setup_not_engaged),
			 ztest_unit_test(test_attr_lock_enable),
			 ztest_unit_test(test_attr_lock_engage),
			 ztest_unit_test(test_attr_dump),
			 ztest_unit_test(test_attr_dump_with_lock_engaged),
			 ztest_unit_test(test_attr_lock_disable),
			 ztest_unit_test(test_attr_lock_enable),
			 ztest_unit_test(test_attr_lock_engage),
			 ztest_unit_test(test_attr_change_with_lock_engaged),
			 ztest_unit_test(test_attr_lock_disable),
			 ztest_unit_test(
				test_attr_change_with_lock_setup_not_engaged),
			 ztest_unit_test(test_attr_lock_enable),
			 ztest_unit_test(test_attr_lock_engage),
			 ztest_unit_test(test_attr_show_with_lock_engaged),
			 ztest_unit_test(test_attr_lock_disable)
			);
	ztest_run_test_suite(lcz_attr_basic_api_test);
}
```

## src/test_attr.h
```c
/**
 * @file test_attr.h
 * @brief
 *
 * Copyright (c) 2021 Laird Connectivity
 *
 * SPDX-License-Identifier: Apache-2.0
 */
#ifndef __TEST_ATTR_H__
#define __TEST_ATTR_H__

/******************************************************************************/
/* Includes                                                                   */
/******************************************************************************/
#include <zephyr.h>
#include <sys/util.h>
#include <ztest.h>

/******************************************************************************/
/* Global Function Prototypes                                                 */
/******************************************************************************/
void test_attr_setup(void);
void test_attr_defaults(void);
void test_attr_lock_enable(void);
void test_attr_with_lock_setup_not_engaged(void);
void test_attr_with_lock_engaged(void);
void test_attr_lock_disengage(void);
void test_attr_lock_engage(void);
void test_attr_lock_disable(void);
void test_attr_show_with_lock_setup_not_engaged(void);
void test_attr_show_with_lock_engaged(void);
void test_attr_change_with_lock_engaged(void);
void test_attr_change_with_lock_setup_not_engaged(void);
void test_attr_dump(void);
void test_attr_dump_with_lock_setup_not_engaged(void);
void test_attr_dump_with_lock_engaged(void);

#endif /* __TEST_ATTR_H__ */
```
