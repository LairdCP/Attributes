## Kconfig
```kconfig
#
# Copyright (c) 2021 Laird Connectivity
#
# SPDX-License-Identifier: Apache-2.0
#
menuconfig ATTR
	bool "Enable attributes module"
	depends on LCZ_KVP
	select ERRNO_STR

if ATTR

config ATTR_BROADCAST
	bool "Send framework broadcast when values change"
	depends on FRAMEWORK
	help
	  Broadcast flag must be set in attributes.json

config ATTR_INIT_PRIORITY
	int "Init priority Application for attribute module"
	range 2 99
	default 70
	help
	  Can't be higher than LCZ_KVP_INIT_PRIORITY.
	  Recommended to be higher than main thread init priority.

config ATTR_FILE_NAME
	string "File name for attributes"
	default "attr.txt"

config ATTR_VALIDATE_ENTIRE_FILE_ON_INIT
	bool "Only load saved attributes if entire file passes validation"
	help
	  If this is true, then if values are removed or their ranges are
	  changed, then none of the file will be loaded.

config ATTR_VALIDATE_ENTIRE_FILE
	bool "Only load attribute file if entire file passes validation"
	default y

config ATTR_SHELL
	bool "Enable Attribute Shell"
	depends on SHELL

if ATTR_SHELL

config ATTR_SHELL_FACTORY_RESET_MSG
	bool "Enable generation of factory reset message from shell"
	depends on FRAMEWORK
	default y if ATTR_SHELL && FRAMEWORK

config ATTR_SHELL_DATA_MANIPULATION
	bool "Enable data manipilation functions"
	help
	  Allows shell functions that can be used to manipulate data in
	  the attribute module, bypassing restrictions.

	  Note: As this bypasses limitations placed on the attributes
	        module, it should not be used for secure production code.

config ATTR_SHELL_NOTIFICATIONS
	bool "Enable notification manipulation functions"
	depends on CONFIG_MCUMGR_SMP_BT
	help
	  Allows attributes notification to be turned on/off.

choice ATTR_SHELL_CONFIG_MANIPULATION_MODE
	prompt "Configuration manipulation"
	default ATTR_SHELL_CONFIG_MANIPULATION_ALL
	help
	  Allows shell functions that can be used to manipulate
	  configuration in the attribute module.

config ATTR_SHELL_CONFIG_MANIPULATION_ALL
	bool "All enabled (unrestricted)"
	help
	  Allows all attribute shell configuration manipulation
	  functions.

	  Note: As this can bypass limitations placed on the attributes
	        module, it should not be used for secure production code.

config ATTR_SHELL_CONFIG_MANIPULATION_LIMITED
	bool "Limited functionality"
	help
	  Allows load and dump attribute shell configuration
	  manipulation functions, other shell configuration functions
	  are disabled.

config ATTR_SHELL_CONFIG_MANIPULATION_NONE
	bool "Disabled"
	help
	  Disables all attribute shell configuration manipulation
	  functions.

endchoice

config ATTR_SHELL_QRTC_SET
	bool "Enable QRTC set function"
	help
	  Allows setting the QRTC value from the shell.

endif # ATTR_SHELL

config ATTR_SHOW_FMT
	string "Format for the attribute show command index name"
	default "[%03u] %-30s"

config ATTR_DEFERRED_SAVE
	bool "Enable deferred attribute saving"
	help
	  This enables deferred saving of attribute data to storage,
	  which saves the attributes data in the background on a timer.
	  If this option is disabled and 5 attributes are changed in a
	  row, this results in 5 erase/write cycles, with this option
	  enabled it will keep the changes in RAM and then write them
	  out later, resulting in 1 erase/write cycle.

	  Note: Due to deferring the save process, this increases the
	        chances of losing attribute data if e.g. power is lost
	        prior to an update cycle running and completing.

if ATTR_DEFERRED_SAVE

config ATTR_SAVE_DELAY_MS
	int "Time (in ms) before saving attributes to storage"
	default 30000
	range 1000 3600000
	help
	  This is how long after an attribute is changed before the
	  change will be written back to the storage device (which will
	  also include any additional changes up to the point of save).

endif # ATTR_DEFERRED_SAVE

config MCUMGR_CMD_ATTRIBUTE_MGMT
	bool "Enable the attribute MCUMGR interface"
	depends on MCUMGR

if MCUMGR_CMD_ATTRIBUTE_MGMT

config ATTRIBUTE_MGMT_MEMFAULT_FILE_NAME
	string "File name used for writing memfault data"
	depends on LCZ_MEMFAULT_FILE
	default "/lfs/mflt.bin"

config ATTRIBUTE_MGMT_FACTORY_RESET
	bool "Factory reset request support"
	help
	  Adds support for issuing a factory reset command to the
	  application.

config ATTRIBUTE_MGMT_DUMP_USER_FILE_NAME
	bool "Allow user-specified dump file name"
	help
	  Allows the user to select the output file name and path to
	  dump the attributes to when using the SMP dump command,
	  otherwise uses the value in the attribute.

config MGMT_GROUP_ID_ATTRIBUTE
	int "MCU manager group id for attribute management"
	default 65

config ATTRIBUTE_MGMT_INCREMENT_CONFIG_VERSION
	bool "Increment config version from SMP set attribute"
	help
	  Will increment the configuration version attribute upon a
	  successful SMP set attribute being executed, requires the
	  config version attribute to be present.

endif # MCUMGR_CMD_ATTRIBUTE_MGMT

config ATTR_LOAD_FEEDBACK
	bool "Create feedback files when loading parameters"
	help
	  When enabled, will create feedback files when the SMP or shell
	  load parameter commands are used which can then be retrieved
	  to see if any attributes could not be set.

config ATTRIBUTE_FEEDBACK_FILE
	string "File name used for feedback for load function"
	depends on ATTR_LOAD_FEEDBACK
	default "/lfs1/attr_feedback.txt"

config ATTR_ENCRYPTED
	bool "Encrypt attribute files"
	depends on FSU_ENCRYPTED_FILES
	help
	  When enabled, attribute and attribute load files will be
	  encrypted.

config ATTR_ID_CONDITIONAL_CODE_ENABLE
	bool "Allow preprocssor resolution of attribute names into ids"
	help
	  When enabled undefined attribute names return invalid id when
	  use with ATTR_ID macro.
	  When disabled undefined attribute names
	  will result in compilation errors.

config ATTR_CUSTOM_VALIDATOR
	bool "Enable inclusion of custom validator header file"
	help
	  If custom validators are present in the API, they
	  must be defined by the application.

# Include logging configuration
module = ATTR
module-str = ATTR
source "subsys/logging/Kconfig.template.log_config"

# Include logging configuration for attribute validation
module = ATTR_VALIDATION
module-str = ATTR_VALIDATION
source "subsys/logging/Kconfig.template.log_config"

endif # ATTR
```

## Kconfig.attribute
```kconfig
#
# Copyright (c) 2021 Laird Connectivity
#
# SPDX-License-Identifier: Apache-2.0
#
menuconfig ATTR
	bool "Enable attribute/parameters module"
	#depends on FILE_SYSTEM_UTILITIES
	#depends on LCZ
	#depends on LCZ_PARAM_FILE

if ATTR

config ATTR_BROADCAST
	bool "Send framework broadcast when values change"
	#depends on FRAMEWORK
	help
	  Broadcast flag must be set in attributes.json

config ATTR_INIT_PRIORITY
	int "Init priority Application for attribute module"
	range 2 99
	default 2
	help
	  Can't be higher than LCZ_PARAM_FILE_INIT_PRIORITY.
	  Recommended to be higher than main thread init priority.

config ATTR_LOG_LEVEL
	int "Log level for Attributes module"
	range 0 4
	default 3

config ATTR_FILE_NAME
	string "File name for attributes"
	default "attr.txt"

config ATTR_BREAK_ON_LOAD_FAILURE
	bool "Stop loading on first failure"

config ATTR_SHELL
	bool "Enable Attribute Shell"
	depends on SHELL

config ATTR_SHELL_SHOW_ALL_DELAY_MS
	int "Amount of time to delay between each debug log print"
	depends on ATTR_SHELL
	default 10
	help
	  This is used to prevent log system overflow.

config ATTR_SHELL_FACTORY_RESET_MSG
	bool "Enable generation of factory reset message from shell"
	depends on ATTR_SHELL
	depends on FRAMEWORK
	default y if ATTR_SHELL && FRAMEWORK

config ATTR_SHOW_FMT
	string "Format for the attribute show command index name"
	default "[%03u] %-30s"

config ATTR_FLOAT_FMT
	string "Default format for floats"
	default "%.4e"

config ATTR_FLOAT_MAX_STR_SIZE
	int "Number of characters (and NULL) for floats converted to string"
	default 13
	help
	  An example with ATTR_FLOAT_FMT of %0.4e is -2.8171e+000.

config ATTR_DEFERRED_SAVE
	bool "Enable deferred attribute saving"
	help
	  This enables deferred saving of attribute data to storage,
	  which saves the attributes data in the background on a timer.
	  If this option is disabled and 5 attributes are changed in a
	  row, this results in 5 erase/write cycles, with this option
	  enabled it will keep the changes in RAM and then write them
	  out later, resulting in 1 erase/write cycle.

	  Note: Due to deferring the save process, this increases the
	        chances of losing attribute data if e.g. power is lost
	        prior to an update cycle running and completing.

if ATTR_DEFERRED_SAVE

config ATTR_SAVE_DELAY_MS
	int "Time (in ms) before saving attributes to storage"
	default 30000
	range 1000 3600000
	help
	  This is how long after an attribute is changed before the
	  change will be written back to the storage device (which will
	  also include any additional changes up to the point of save).

endif # ATTR_DEFERRED_SAVE

config ATTR_SETTINGS_LOCK
	bool "Enable settings lock"
	help
	  The settings lock can be used to restrict altering module
	  configuration/settings by protecting it with a 6-digit
	  passcode. Once set and enabled, the settings passcode must be
	  entered prior to making changes to configuration.

if ATTR_SETTINGS_LOCK

config ATTR_INDEX_SETTINGS_PASSCODE
	int "Attribute index for settings password value"
	default 100
	help
	  The attribute index which holds the passcode values. This
	  attribute should be set so that is not printed out via the
	  shell commands or parameter dumps.

config ATTR_INDEX_LOCK
	int "Attribute index for lock value"
	default 5
	help
	  The attribute index which holds the saved lock status when
	  the units powers up.

config ATTR_INDEX_LOCK_STATUS
	int "Attribute index for lock status"
	help
	  The attribute index which holds the current (active) lock
	  status.

config ATTR_INDEX_SETTINGS_PASSCODE_STATUS
	int "Attribute index for settings passcode status"
	help
	  The attribute index which holds the passcode status and is
	  used to notify a client on the passcode entry result.

config ATTR_SHELL_LOCK
	bool "Enable settings lock shell manipulation"
	depends on SHELL
	default y if SHELL
	help
	  Allows the configuration lock to be enabled, disabled, set,
	  removed and checked via the 'lock' shell commands.

endif # ATTR_SETTINGS_LOCK

config MCUMGR_CMD_SENTRIUS_MGMT
	bool "Enable the Sentrius MCUMGR interface"
	depends on MCUMGR
	select CBOR_FLOATING_POINT
	select CBOR_HALF_FLOAT_TYPE

config SENTRIUS_MGMT_MEMFAULT_FILE_NAME
	string "File name used for writing memfault data"
	depends on MCUMGR_CMD_SENTRIUS_MGMT
	depends on LCZ_MEMFAULT_FILE
	default "/lfs/mflt.bin"

config MGMT_GROUP_ID_SENTRIUS
	int "MCU manager group id"
	default 65

config ATTR_DEVICE_OVERRIDE
	bool "Enable attribute name override"
	help
	  Will allow manual overriding of the files used for custom
	  attributes in the custom folder.

if ATTR_DEVICE_OVERRIDE

config ATTR_DEVICE_OVERRIDE_NAME
	string "File name for attributes"
	help
	  Override name to load files from in custom folder.

config ATTR_DEVICE_OVERRIDE_SOURCE_FOLDER
	bool "Use source folder as base for attributes"
	help
	  Will use the current project's source folder as the base
	  folder for where custom attribute files are located instead
	  of the 'custom' folder in the attributes module folder.

endif # ATTR_DEVICE_OVERRIDE

endif # ATTR
```

## tests/display_options/testcase.yaml
```yaml
tests:
  components.attr.display_options:
    tags: attributes
    harness: ztest
```
